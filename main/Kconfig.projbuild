## main/Kconfig.projbuild
```kconfig
menu "Example Configuration"

config WIFI_SSID
    string "WiFi SSID"
	default "myssid"
	help
		SSID (network name) for the example to connect to.

config WIFI_PASSWORD
    string "WiFi Password"
	default "myssid"
	help
		WiFi password (WPA or WPA2) for the example to use.

		Can be left blank if the network has no security set.

config CONNECTION_STRING
    string "Azure IoT Hub Connection String"
	default "HostName=<host_name>;DeviceId=<device_id>;SharedAccessKey=<device_key>"
	help
		String containing Hostname, Device Id & Device Key in the format:

		"HostName=<host_name>;DeviceId=<device_id>;SharedAccessKey=<device_key>"

endmenu
```
